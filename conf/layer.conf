## conf/layer.conf
```bitbake
# We have a conf and classes directory, add to BBPATH
BBPATH .= ":${LAYERDIR}"

# We have a packages directory, add to BBFILES
BBFILES += "${LAYERDIR}/recipes-*/*/*.bb \
            ${LAYERDIR}/recipes-*/*/*.bbappend"

BBFILE_COLLECTIONS      += "tc-overlay"
BBFILE_PATTERN_tc-overlay   = "^${LAYERDIR}/"
BBFILE_PRIORITY_tc-overlay  = "10"

LAYERDEPENDS_tc-overlay = "qcom"
LAYERSERIES_COMPAT_tc-overlay = "kirkstone"
```
